## config/boards/shields/chalk42/Kconfig.defconfig
```kconfig
if SHIELD_CHALK42_LEFT

config ZMK_KEYBOARD_NAME
    default "chalk42"

config ZMK_SPLIT_ROLE_CENTRAL
    default y

endif

if SHIELD_CHALK42_LEFT || SHIELD_CHALK42_RIGHT

config ZMK_SPLIT
    default y

endif
```

## config/boards/shields/chalk42/Kconfig.shield
```kconfig
config SHIELD_CHALK42_LEFT
    def_bool $(shields_list_contains, chalk42_left)

config SHIELD_CHALK42_RIGHT
    def_bool $(shields_list_contains, chalk42_right)
```
